## config/west.yml
```yaml
manifest:
  remotes:
    - name: zmkfirmware
      url-base: https://github.com/zmkfirmware
    - name: humancomputing
      url-base: https://github.com/HumanComputingInc

  projects:
    - name: zmk
      remote: zmkfirmware
      revision: main
      import: app/west.yml
    - name: zmk-iqs5xx-driver
      remote: humancomputing
      repo-path: zmk-keyboard-iqs5xx-dev
      revision: main
  self:
    path: config
```
