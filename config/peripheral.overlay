/ {
    iqs5xx: iqs5xx@44 {
        compatible = "azoteq,iqs5xx";
        reg = <0x44>;
        label = "TPS43";

        irq-gpios = <&gpio0 7 GPIO_ACTIVE_LOW>;
        reset-gpios = <&gpio0 6 GPIO_ACTIVE_LOW>;

        status = "okay";

        azoteq,scroll-mode;
        azoteq,gestures-enabled;
    };
};

&i2c0 {
    status = "okay";
    clock-frequency = <I2C_BITRATE_FAST>;
};

&kscan {
    status = "okay";
};
